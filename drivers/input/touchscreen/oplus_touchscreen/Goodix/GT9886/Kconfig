## drivers/input/touchscreen/oplus_touchscreen/Goodix/GT9886/Kconfig
```kconfig
config TOUCHPANEL_GOODIX_GT9886
	bool "TP Goodix gt9886 IC enable or not for OPLUS"
	---help---
	  say Y to enable driver for Touchpanel using Goodix gt9886
```

## drivers/soc/oplus/Kconfig
```kconfig
#ifdef OPLUS_FEATURE_TP_BASIC
source "drivers/soc/oplus/device_info/Kconfig"
#endif /* OPLUS_FEATURE_TP_BASIC */
#ifdef OPLUS_FEATURE_ESIM
source "drivers/soc/oplus/misc/Kconfig"
#endif /* OPLUS_FEATURE_ESIM */
#ifdef OPLUS_FEATURE_SENSOR_SMEM
source "drivers/soc/oplus/sensor/Kconfig"
#endif /* OPLUS_FEATURE_SENSOR_SMEM */
#ifdef VENDOR_EDIT
source "drivers/soc/oplus/system/Kconfig"
#endif /* VENDOR_EDIT */
#ifdef OPLUS_FEATURE_THERMAL_HORAE
source "drivers/soc/oplus/thermal/Kconfig"
#endif /* OPLUS_FEATURE_THERMAL_HORAE */

config OPLUS_EBBA_LEGACY_DISPLAY
	bool "Use legacy OnePlus Nord CE display startup"
	depends on ARCH_LAGOON
	help
	  Test the original Ebba DSI PHY LDO setting and send display-on
	  after the first brightness write with an 8-10 ms delay.
```
